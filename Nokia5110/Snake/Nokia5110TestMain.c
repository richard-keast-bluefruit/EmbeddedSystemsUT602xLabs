// Nokia5110TestMain.c
// Runs on LM4F120/TM4C123
// Test the functions in Nokia5110.c by printing various
// things to the LCD.
// Daniel Valvano
// September 16, 2013

// Font table, initialization, and other functions based
// off of Nokia_5110_Example from Spark Fun:
// 7-17-2011
// Spark Fun Electronics 2011
// Nathan Seidle
// http://dlnmh9ip6v2uc.cloudfront.net/datasheets/LCD/Monochrome/Nokia_5110_Example.pde

/* This example accompanies the book
   "Embedded Systems: Real Time Interfacing to Arm Cortex M Microcontrollers",
   ISBN: 978-1463590154, Jonathan Valvano, copyright (c) 2014

 Copyright 2014 by Jonathan W. Valvano, valvano@mail.utexas.edu
    You may use, edit, run or distribute this file
    as long as the above copyright notice remains
 THIS SOFTWARE IS PROVIDED "AS IS".  NO WARRANTIES, WHETHER EXPRESS, IMPLIED
 OR STATUTORY, INCLUDING, BUT NOT LIMITED TO, IMPLIED WARRANTIES OF
 MERCHANTABILITY AND FITNESS FOR A PARTICULAR PURPOSE APPLY TO THIS SOFTWARE.
 VALVANO SHALL NOT, IN ANY CIRCUMSTANCES, BE LIABLE FOR SPECIAL, INCIDENTAL,
 OR CONSEQUENTIAL DAMAGES, FOR ANY REASON WHATSOEVER.
 For more information about my classes, my research, and my books, see
 http://users.ece.utexas.edu/~valvano/
 */

// Blue Nokia 5110
// ---------------
// Signal        (Nokia 5110) LaunchPad pin
// Reset         (RST, pin 1) connected to PA7
// SSI0Fss       (CE,  pin 2) connected to PA3
// Data/Command  (DC,  pin 3) connected to PA6
// SSI0Tx        (Din, pin 4) connected to PA5
// SSI0Clk       (Clk, pin 5) connected to PA2
// 3.3V          (Vcc, pin 6) power
// back light    (BL,  pin 7) not connected
// Ground        (Gnd, pin 8) ground

// Red SparkFun Nokia 5110 (LCD-10168)
// -----------------------------------
// Signal        (Nokia 5110) LaunchPad pin
// 3.3V          (VCC, pin 1) power
// Ground        (GND, pin 2) ground
// SSI0Fss       (SCE, pin 3) connected to PA3
// Reset         (RST, pin 4) connected to PA7
// Data/Command  (D/C, pin 5) connected to PA6
// SSI0Tx        (DN,  pin 6) connected to PA5
// SSI0Clk       (SCLK, pin 7) connected to PA2
// back light    (LED, pin 8) not connected

#include <stdint.h>
#include "Nokia5110.h"
#include "PLL.h"

// delay function for testing from sysctl.c
// which delays 3*ulCount cycles
#ifdef __TI_COMPILER_VERSION__
	//Code Composer Studio Code
	void Delay(uint32_t ulCount){
	__asm (	"    subs    r0, #1\n"
			"    bne     Delay\n"
			"    bx      lr\n");
}

#else
	//Keil uVision Code
	__asm void
	Delay(uint32_t ulCount)
	{
    subs    r0, #1
    bne     Delay
    bx      lr
	}
#endif

// image of a face
const uint8_t Face[] = {
0x00, 0x00, 0x00, 0x00, 0x00, 0x00, 0x00, 0x00, 0x00, 0x00, 0x00, 0x00, 0x00, 0x80, 0xC0, 0xC0,
0xE0, 0xE0, 0xF0, 0xF0, 0xF0, 0xF0, 0xF0, 0xF0, 0xF0, 0xF8, 0xF6, 0xFC, 0xFE, 0xFE, 0xFE, 0xFE,
0xFE, 0xFE, 0xFF, 0xFF, 0xFF, 0xFF, 0xFF, 0xFF, 0xFF, 0xFE, 0xFF, 0xFF, 0xFF, 0xFE, 0xFE, 0xFE,
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0x00, 0x00, 0x00, 0x00, 0x00, 0x00, 0x00, 0x00, 
};

void DrawBorder();
void DrawFood(uint32_t x, uint32_t y);
void DrawSnakeSegment(uint32_t x, uint32_t y);

int main(void){
  uint32_t count = 0;
  PLL_Init();                           // set system clock to 50 MHz
  Nokia5110_Init();
  Nokia5110_DrawFullImage(Face);
  for(count=0; count<2; count=count+1)
  {
    Delay(16666667);                    // delay ~1 sec at 50 MHz
  }
  count = 0;
  Nokia5110_Clear();
  DrawBorder();
  DrawFood(10, 10);
  DrawSnakeSegment(10, 16);
  DrawSnakeSegment(10, 19);
  DrawSnakeSegment(10, 22);
  DrawSnakeSegment(10, 25);
  DrawSnakeSegment(10, 28);
  DrawSnakeSegment(13, 28);
  DrawSnakeSegment(16, 28);
  DrawSnakeSegment(19, 28);
  DrawSnakeSegment(22, 28);
  DrawSnakeSegment(22, 31);
  DrawSnakeSegment(22, 34);
  Nokia5110_DisplayBuffer();
  //Nokia5110_OutString("************* LCD Test *************Letter: Num:------- ---- ");
  //Nokia5110_OutChar(127);               // print UT sign
  while(1){
    //Nokia5110_SetCursor(5, 5);          // five leading spaces, bottom row
    //Nokia5110_OutChar((count%26)+'A');
    //Nokia5110_OutChar(' ');
    //Nokia5110_OutUDec(count);
    //Delay(8333333);                     // delay ~0.5 sec at 50 MHz
    //count = count + 1;
  }
}

void DrawBorder()
{
   uint32_t i = 0;
   for (i = 0 ; i < MAX_X ; i++)
   {
      Nokia5110_SetPxl(0, i);
      Nokia5110_SetPxl(MAX_Y - 1, i);
   }
   for (i = 0 ; i < MAX_Y ; i++)
   {
      Nokia5110_SetPxl(i, 0);
      Nokia5110_SetPxl(i, MAX_X - 1);
   }
}

void DrawFood(uint32_t x, uint32_t y)
{
   Nokia5110_SetPxl(y, x + 1);
   Nokia5110_SetPxl(y + 1, x);
   Nokia5110_SetPxl(y + 1, x + 2);
   Nokia5110_SetPxl(y + 2, x + 1);
}

void DrawSnakeSegment(uint32_t x, uint32_t y)
{
   Nokia5110_SetPxl(y, x);
   Nokia5110_SetPxl(y, x + 1);
   Nokia5110_SetPxl(y, x + 2);
   Nokia5110_SetPxl(y + 1, x);
   Nokia5110_SetPxl(y + 1, x + 1);
   Nokia5110_SetPxl(y + 1, x + 2);
   Nokia5110_SetPxl(y + 2, x);
   Nokia5110_SetPxl(y + 2, x + 1);
   Nokia5110_SetPxl(y + 2, x + 2);
}
